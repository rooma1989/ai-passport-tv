## components/bsp/Kconfig
```kconfig
menu "AI Passport TV board"

    choice AV_BOARD
        prompt "Target board"
        default AV_BOARD_XINGZHI_CUBE_154 if IDF_TARGET_ESP32S3
        default AV_BOARD_PASSPORT
        help
            Which board the BSP drives. Each board's pins are in
            components/bsp/include/boards/.

        config AV_BOARD_PASSPORT
            bool "FoloToy AI Passport (ESP32-C3)"
            depends on IDF_TARGET_ESP32C3

        config AV_BOARD_XINGZHI_CUBE_154
            bool "Xingzhi Cube 1.54 TFT (ESP32-S3)"
            depends on IDF_TARGET_ESP32S3
    endchoice

endmenu
```

## main/Kconfig.projbuild
```kconfig
menu "Local audio/video prototype"
config AV_RAW_PROTOTYPE
    bool "Boot standalone raw FAV1 LAN test instead of LVGL demo"
    default n
    help
        Exclusive landscape JPEG/PCM test; does not start LVGL or BLE.
        Supply ignored main/av_private_config.h. No flashing is performed.

config AV_SCREEN_CAPTURE
    bool "Take one screen capture per session and print it to the console"
    depends on AV_RAW_PROTOTYPE
    default n
    help
        Prints a 80x60 subsample of the panel's own input as hex between two
        markers, which tools/screen_capture.py turns into a PNG.

        This is the only way to see what the panel is actually given. Every
        check that compares the server's output against itself, or against a
        second rendering of the same frames, is blind to a fault on the
        device's side of the wire -- and the screen cannot be read from a
        distance. It cost three wrong hypotheses about the colour before this
        existed.

        Off by default: it holds 9600 bytes of heap for one session and prints
        sixty lines of hex, neither of which belongs in an ordinary build.
config AV_VOICE
    bool "Push-to-talk voice control: hold OK and speak"
    depends on AV_RAW_PROTOTYPE
    default y
    help
        Hold OK for AV_VOICE_HOLD_MS while playing (or in the channel list)
        and speak; let go and the server recognises the words and the device
        switches channel, changes the volume and so on. Design:
        docs/superpowers/specs/2026-10-12-voice-control-design.md.

        Inert until a server offers it: voice is only turned on by a CONFIG
        that carries "voice", which a server sends only when it has a speech
        recogniser. Until then, and with this option off, the keys are
        exactly what they were. On, the Xingzhi's backlight page moves from
        OK's 1.5 s long press to an OK triple-click, and the channel list's
        "back" from OK's long press to a double-click.

        Costs about 13 KB of heap while OK is held (freed afterwards) and a
        few kilobytes of code. Not yet verified on either board's microphone.

config AV_VOICE_HOLD_MS
    int "How long OK is held before it means talking (ms)"
    depends on AV_VOICE
    range 300 1200
    default 450
    help
        A click is reported 180 ms after release (the button component's
        short-press window), so deliberate clicks stay well under this.
        Capture starts at press-down either way, so speech that begins before
        the threshold is kept.

config AV_USB_TRANSPORT
    bool "Also carry the media stream over the USB cable (measurement builds only)"
    depends on AV_RAW_PROTOTYPE
    default n
    help
        Adds a second transport: the same FAV1 packets down the USB cable
        instead of over the network. Off by default, and the default is the
        product: this device is a network set-top box, and a build that
        prefers a cable whenever one is plugged in is a different product,
        not a faster version of this one.

        On, it exists so the two transports can be measured against each
        other on the same hardware -- which is the only way to say what the
        network path is actually giving up. The reference implementation
        reaches 20 frames a second over this same USB peripheral, and the
        number this build produces answers whether that gap is the transport
        or something about this firmware.

        It costs about 20 KB of internal RAM for the driver's ring buffers,
        held for the life of the device, which is another reason it is not on.

config AV_DISPLAY_BENCH
    bool "Measure the display path in isolation, with the link frozen out"
    depends on AV_RAW_PROTOTYPE
    default n
    help
        Two things a normal build has no way to ask.

        First, a bare panel benchmark: fill a stripe buffer with a constant
        and submit it 15 times a frame for 60 frames, timing the whole run and
        each part of it. It never decodes anything and never reads a socket.
        This is the only measurement of the 4-wire SPI bus at its configured
        clock (BSP_LCD_PCLK_HZ, 80 MHz) and therefore the only check on the
        15.4 ms floor every other figure in this project is compared against --
        a floor that has so far been arithmetic rather than an observation.

        Second, a stop-the-world freeze. On a serial command the receive task
        stops reading its socket while the picture task carries on consuming
        whatever packets are already queued, and logs the rate it drains them
        at. That rate is the device drawing with no network in the way at all:
        no packet arrival times, no TCP window, no sender pacing. Every
        previous attempt to measure the device's own drawing speed was taken
        during a live session and was therefore measuring the link's supply
        rate instead, which is how "the device is already at the hardware
        floor" got written down twice on evidence that could not show it.

        Off by default. Both measurements need the device quiet and a human
        reading a console, which is not what a set-top box is doing.

config AV_HW_BENCH
    bool "Run the hardware benchmark at boot, before the network starts"
    depends on AV_RAW_PROTOTYPE
    default n
    help
        The successor to AV_DISPLAY_BENCH, and the instrument the handoff of
        2026-09-28 asks for. Every CPU figure in that handoff is arithmetic:
        the cost of receiving a byte, of inflating one, of expanding a pixel.
        None was measured, and the whole optimisation plan is gated on which
        of the three actually binds.

        Three groups, all before any socket exists so nothing here can be
        paced by a sender:

        - The panel, as a bus. Stripe height is swept to separate the fixed
          per-stripe command and synchronisation cost from the pixel clock,
          and one variant sets the window once and pushes the whole frame
          without re-sending it. Two more sweep COLMOD and the SPI clock,
          both of which leave the chip's rated envelope and are therefore
          only meaningful with a human looking at the screen.

        - The CPU, in cycles, on synthesised stripes of known entropy:
          memcpy, ROM tinfl at four compression ratios, the current expander,
          an optimised expander, and a 4x4 block decoder prototype.

        - The receive path, which is the least certain figure of the three
          and the one that sets the CPU ceiling.

        Everything prints as `BENCH name=... key=value` on one line per item,
        which tools/bench_summary.py reads.

        Off by default, and it runs before the network comes up: a device that
        benchmarks on every boot is not a television. AV_DISPLAY_BENCH may be
        on at the same time; the two do not share state.

config AV_DEMO_PLAYBACK
    bool "Boot a self-contained playback demo with a live frame-rate readout"
    depends on AV_RAW_PROTOTYPE
    default n
    help
        Plays a short clip stored in the firmware image, on a loop, with no
        network and no server, and draws the measured frame rate and the cost
        of each stage over the picture.

        The clip is stored the way the wire carries it -- one zlib stream per
        12-row stripe of 3-3-2 indexed pixels -- and drawn by the same steps as
        the product: inflate, expand through the palette, submit to the raw
        panel with one transfer kept in flight. So the number on screen is what
        this pipeline does with the link taken out of it, not a synthetic bus
        figure.

        Off by default, and it embeds main/demo_clip.bin (regenerate with
        tools/make_demo_clip.py), so a build that does not ask for it carries
        neither the clip nor the code. Turn it on with the overlay
        tools/sdkconfig.playback-demo, not with `idf.py -D`: that form sets a
        CMake variable and leaves this symbol off.
config AV_NET_DEMO
    bool "Boot a minimal network playback benchmark (bypasses the product player)"
    depends on AV_RAW_PROTOTYPE
    default n
    help
        Boots tools/net_demo_server.py's counterpart: a small receiver that
        shares nothing with the product's session, receive task or packet
        protocol. Step 1 draws colour bars, step 2 measures raw TCP receive
        rate, step 3 receives, inflates and draws unpaced frames so the frame
        rate on screen is the ceiling of the whole network path. Off by
        default; enable with tools/sdkconfig.net-demo, not `idf.py -D`.
config AV_JPEG_BENCH
    bool "Boot a JPEG decode-speed benchmark (bypasses the player)"
    depends on AV_RAW_PROTOTYPE
    default n
    help
        Decodes embedded 320x180 4:2:0 JPEG frames with the ROM TJpgDec and
        prints per-tier decode time. Off by default; enable with
        tools/sdkconfig.jpeg-bench. Embeds main/jpeg_test.bin
        (tools/make_jpeg_clip.py).
config AV_DEFAULT_SERVER
    string "Streaming server this build uses when none is stored (host[:port])"
    depends on AV_RAW_PROTOTYPE
    default ""
    help
        A public build's default server, so the setup page only asks for the
        Wi-Fi network and its password: the server field moves behind a small
        "Advanced" toggle there. An address stored on the setup page (or sent
        by sound provisioning) still takes precedence, and a private build's
        compiled-in address (main/av_private_config.h) comes before this.

        Set it in the build's own sdkconfig (which git ignores), never in a
        committed defaults file: host names and addresses stay out of the
        repository. Empty means no default, as before.

config AV_DEFAULT_SERVER_PORT
    int "Port of the streaming server this build is made for"
    depends on AV_RAW_PROTOTYPE
    range 1 65535
    default 8098 if AV_BOARD_XINGZHI_CUBE_154
    default 8097
    help
        Dialled when a server address names no port -- "example.com" typed on
        the setup page or sent from the phone means example.com on this port.
        The relay listens on 8097 for the AI Passport and 8098 for the Xingzhi
        board. An address with an explicit port keeps it, except "name:8096"
        on a public DNS name, which earlier firmware stored and which moves to
        this port (see main/av_server_addr.h). A private build's
        av_private_config.h sets AV_SERVER_PORT itself and this is not used.
        For the local media server (server/tv_server.py, port 8096) type the
        port: "192.168.1.20:8096".

config AV_PUBLIC_SITE
    string "Public site of the phone remote (https://host), for the setup screen"
    depends on AV_RAW_PROTOTYPE
    default ""
    help
        Where the phone remote is served, e.g. https://example.com. The setup
        screen's first page shows a code for <site>/tv/wifi, the phone page
        that sends the network to the device as sound. A device that has
        been online learns the site from the server (CONFIG's remote_url)
        and remembers it; this is the answer before that. A private build
        also derives it from AV_HELP_URL. Like AV_DEFAULT_SERVER, set it only
        in a git-ignored sdkconfig.

config AV_SOUNDPROV_DUMP
    bool "Print the setup screen's microphone audio to the console (sound setup debugging)"
    depends on AV_RAW_PROTOTYPE
    default n
    help
        When a sound message starts arriving on the setup screen (the decoder's
        progress rises above 0), print half a second from before it and then
        AV_SOUNDPROV_DUMP_S seconds of the 16 kHz microphone signal as
        "SNDDUMP" lines. tools/soundprov_dump.py turns a saved console log
        into a WAV that tests/test_av_soundprov --wav replays, so a capture
        that failed in a room can be studied on a computer.

        Off by default: it holds 16 KB for the half-second ring, and prints
        about 45 KB of text per second while dumping, which can delay the
        reads enough to cost the decoder samples on a slow console.

config AV_SOUNDPROV_DUMP_S
    int "Seconds of microphone audio to print per message"
    depends on AV_SOUNDPROV_DUMP
    range 1 30
    default 10

config AV_MUSE_DUAL
    bool "Run from the Muse gadget firmware's second app slot"
    depends on AV_RAW_PROTOTYPE
    default n
    help
        For the AI Passport carrying the Muse gadget firmware in ota_0 and this
        player in ota_1 (sdkconfig.muse-dual, partitions-muse-dual.csv). The
        player marks itself valid for Muse's rollback-enabled bootloader, takes
        Muse's Wi-Fi on a first boot, never erases the shared NVS, and goes
        back to Muse on a double-click of OK on the status page.

endmenu
```
